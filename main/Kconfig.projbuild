## main/Kconfig.projbuild
```kconfig
menu "WiFi Configuration"

    config WIFI_SSID
        string "WiFi SSID"
        default "myssid"
        help
            SSID (network name) for the example to connect to.

    config WIFI_PASSWORD
        string "WiFi Password"
        default "mypassword"
        help
            WiFi password (WPA or WPA2) for the example to use.

    config WIFI_MAXIMUM_RETRY
        int "Maximum retry"
        default 420
        help
            Set the Maximum retry to avoid station reconnecting to the AP unlimited when the AP is really inexistent.

    choice WIFI_SCAN_AUTH_MODE_THRESHOLD
        prompt "WiFi Scan auth mode threshold"
        default ESP_WIFI_AUTH_WPA2_PSK
        help
            The weakest authmode to accept in the scan mode.
            This value defaults to ESP_WIFI_AUTH_WPA2_PSK incase password is present and ESP_WIFI_AUTH_OPEN is used.
            Please select ESP_WIFI_AUTH_WEP/ESP_WIFI_AUTH_WPA_PSK incase AP is operating in WEP/WPA mode.

        config ESP_WIFI_AUTH_OPEN
            bool "OPEN"
        config ESP_WIFI_AUTH_WEP
            bool "WEP"
        config ESP_WIFI_AUTH_WPA_PSK
            bool "WPA PSK"
        config ESP_WIFI_AUTH_WPA2_PSK
            bool "WPA2 PSK"
        config ESP_WIFI_AUTH_WPA_WPA2_PSK
            bool "WPA/WPA2 PSK"
        config ESP_WIFI_AUTH_WPA3_PSK
            bool "WPA3 PSK"
        config ESP_WIFI_AUTH_WPA2_WPA3_PSK
            bool "WPA2/WPA3 PSK"
        config ESP_WIFI_AUTH_WAPI_PSK
            bool "WAPI PSK"
    endchoice

endmenu

menu "Testing Configuration"
    config MOCK_POOL
        default false
        bool "Mock Pool & WIFI"
        help
            Mock the pool & wifi. Will use mocked requests instead.
endmenu

menu "Pool Configuration"
    config POOL_PRIMARY_URL
        string "Primary POOL Address"
        default "nyc.kano.is"
        help
            The example will connect to this POOL pool address.

    config POOL_PRIMARY_PORT
        int "Primary POOL Port"
        range 0 65535
        default 3333
        help
            The POOL server port to connect to.

    config POOL_FALLBACK_URL
        string "Fallback POOL Address"
        default "nyc.kano.is"
        help
            The example will connect to this POOL pool address if the primary fails.

    config FALLBACK_POOL_PORT
        int "Fallback POOL Port"
        range 0 65535
        default 3333
        help
            The POOL server port to connect to if the primary fails.

    config POOL_USER
        string "POOL username"
        default "replace-this-with-your-btc-address.bitaxe"
        help
            POOL user to use with pool

    config POOL_PW
        string "POOL password"
        default "x"
        help
            POOL password to use with pool

    config POOL_DIFFICULTY
        int "POOL default difficulty"
        range 0 4294967296
        default 1000
        help
            A starting difficulty to use with the pool.
    

endmenu
```
